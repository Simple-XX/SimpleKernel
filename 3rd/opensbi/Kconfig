## 3rd/opensbi/Kconfig
```kconfig
# SPDX-License-Identifier: BSD-2-Clause

mainmenu "OpenSBI $(OPENSBI_PLATFORM) Configuration"

config OPENSBI_SRC_DIR
	string
	option env="OPENSBI_SRC_DIR"

config OPENSBI_PLATFORM
	string
	option env="OPENSBI_PLATFORM"

config OPENSBI_PLATFORM_SRC_DIR
	string
	option env="OPENSBI_PLATFORM_SRC_DIR"

menu "Platform Options"
source "$(OPENSBI_PLATFORM_SRC_DIR)/Kconfig"
endmenu

source "$(OPENSBI_SRC_DIR)/lib/sbi/Kconfig"

source "$(OPENSBI_SRC_DIR)/lib/utils/Kconfig"

source "$(OPENSBI_SRC_DIR)/firmware/Kconfig"
```

## 3rd/opensbi/lib/utils/ipi/Kconfig
```kconfig
# SPDX-License-Identifier: BSD-2-Clause

menu "IPI Device Support"

config FDT_IPI
	bool "FDT based ipi drivers"
	depends on FDT
	default n

if FDT_IPI

config FDT_IPI_MSWI
	bool "ACLINT MSWI FDT driver"
	select IPI_MSWI
	default n

config FDT_IPI_PLICSW
	bool "Andes PLICSW FDT driver"
	select IPI_PLICSW
	default n

endif

config IPI_MSWI
	bool "ACLINT MSWI support"
	default n

config IPI_PLICSW
	bool "Andes PLICSW support"
	default n

endmenu
```

## 3rd/opensbi/lib/utils/timer/Kconfig
```kconfig
# SPDX-License-Identifier: BSD-2-Clause

menu "Timer Device Support"

config FDT_TIMER
	bool "FDT based timer drivers"
	depends on FDT
	default n

if FDT_TIMER

config FDT_TIMER_MTIMER
	bool "ACLINT MTIMER FDT driver"
	select TIMER_MTIMER
	default n

config FDT_TIMER_PLMT
	bool "Andes PLMT FDT driver"
	select TIMER_PLMT
	default n

endif

config TIMER_MTIMER
	bool "ACLINT MTIMER support"
	default n

config TIMER_PLMT
	bool "Andes PLMT support"
	default n

endmenu
```

## tools/1opensbi/lib/utils/Kconfig
```kconfig
# SPDX-License-Identifier: BSD-2-Clause

menu "Utils and Drivers Support"

source "$(OPENSBI_SRC_DIR)/lib/utils/fdt/Kconfig"

source "$(OPENSBI_SRC_DIR)/lib/utils/gpio/Kconfig"

source "$(OPENSBI_SRC_DIR)/lib/utils/i2c/Kconfig"

source "$(OPENSBI_SRC_DIR)/lib/utils/ipi/Kconfig"

source "$(OPENSBI_SRC_DIR)/lib/utils/irqchip/Kconfig"

source "$(OPENSBI_SRC_DIR)/lib/utils/libfdt/Kconfig"

source "$(OPENSBI_SRC_DIR)/lib/utils/reset/Kconfig"

source "$(OPENSBI_SRC_DIR)/lib/utils/serial/Kconfig"

source "$(OPENSBI_SRC_DIR)/lib/utils/sys/Kconfig"

source "$(OPENSBI_SRC_DIR)/lib/utils/timer/Kconfig"

endmenu
```

## tools/opensbi/lib/sbi/Kconfig
```kconfig
# SPDX-License-Identifier: BSD-2-Clause

menu "SBI Extension Support"

config SBI_ECALL_TIME
	bool "Timer extension"
	default y

config SBI_ECALL_RFENCE
	bool "RFENCE extension"
	default y

config SBI_ECALL_IPI
	bool "IPI extension"
	default y

config SBI_ECALL_HSM
	bool "Hart State Management extension"
	default y

config SBI_ECALL_SRST
	bool "System Reset extension"
	default y

config SBI_ECALL_PMU
	bool "Performance Monitoring Unit extension"
	default y

config SBI_ECALL_LEGACY
	bool "SBI v0.1 legacy extensions"
	default y

config SBI_ECALL_VENDOR
	bool "Platform-defined vendor extensions"
	default y

endmenu
```

## tools/opensbi/lib/utils/fdt/Kconfig
```kconfig
# SPDX-License-Identifier: BSD-2-Clause

menuconfig FDT
	bool "Flattened Device Tree (FDT) support"
	select LIBFDT
	default n

if FDT

config FDT_DOMAIN
	bool "FDT domain support"
	default n

config FDT_PMU
	bool "FDT performance monitoring unit (PMU) support"
	default n

endif
```

## tools/opensbi/lib/utils/gpio/Kconfig
```kconfig
# SPDX-License-Identifier: BSD-2-Clause

menu "GPIO Support"

config FDT_GPIO
	bool "FDT based GPIO drivers"
	depends on FDT
	select GPIO
	default n

if FDT_GPIO

config FDT_GPIO_SIFIVE
	bool "SiFive GPIO FDT driver"
	default n

endif

config GPIO
	bool "GPIO support"
	default n

endmenu
```

## tools/opensbi/lib/utils/i2c/Kconfig
```kconfig
# SPDX-License-Identifier: BSD-2-Clause

menu "I2C Support"

config FDT_I2C
	bool "FDT based I2C drivers"
	depends on FDT
	select I2C
	default n

if FDT_I2C

config FDT_I2C_SIFIVE
	bool "SiFive I2C FDT driver"
	default n

endif

config I2C
	bool "I2C support"
	default n

endmenu
```

## tools/opensbi/lib/utils/irqchip/Kconfig
```kconfig
# SPDX-License-Identifier: BSD-2-Clause

menu "Interrupt Controller Support"

config FDT_IRQCHIP
	bool "FDT based interrupt controller drivers"
	depends on FDT
	default n

if FDT_IRQCHIP

config FDT_IRQCHIP_APLIC
	bool "Advanced Platform Level Interrupt Controller (APLIC) FDT driver"
	select IRQCHIP_APLIC
	default n

config FDT_IRQCHIP_IMSIC
	bool "Incoming Message Signalled Interrupt Controller (IMSIC) FDT driver"
	select IRQCHIP_IMSIC
	default n

config FDT_IRQCHIP_PLIC
	bool "Platform Level Interrupt Controller (PLIC) FDT driver"
	select IRQCHIP_PLIC
	default n

endif

config IRQCHIP_APLIC
	bool "Advanced Platform Level Interrupt Controller (APLIC) support"
	default n

config IRQCHIP_IMSIC
	bool "Incoming Message Signalled Interrupt Controller (IMSIC) support"
	default n

config IRQCHIP_PLIC
	bool "Platform Level Interrupt Controller (PLIC) support"
	default n

endmenu
```

## tools/opensbi/lib/utils/reset/Kconfig
```kconfig
# SPDX-License-Identifier: BSD-2-Clause

menu "System Reset Support"

config FDT_RESET
	bool "FDT based reset drivers"
	depends on FDT
	default n

if FDT_RESET

config FDT_RESET_ATCWDT200
	bool "Andes WDT FDT reset driver"
	default n

config FDT_RESET_GPIO
	bool "GPIO FDT reset driver"
	depends on FDT_GPIO
	default n

config FDT_RESET_HTIF
	bool "Host transfer interface (HTIF) FDT reset driver"
	select SYS_HTIF
	default n

config FDT_RESET_SIFIVE_TEST
	bool "SiFive Test FDT reset driver"
	select SYS_SIFIVE_TEST
	default n

config FDT_RESET_SUNXI_WDT
	bool "Sunxi WDT FDT reset driver"
	default n

config FDT_RESET_THEAD
	bool "T-HEAD FDT reset driver"
	default n

endif

endmenu
```

## tools/opensbi/lib/utils/serial/Kconfig
```kconfig
# SPDX-License-Identifier: BSD-2-Clause

menu "Serial Device Support"

config FDT_SERIAL
	bool "FDT based serial drivers"
	depends on FDT
	default n

if FDT_SERIAL

config FDT_SERIAL_CADENCE
	bool "Cadence UART FDT driver"
	select SERIAL_CADENCE
	default n

config FDT_SERIAL_GAISLER
	bool "Gaisler UART FDT driver"
	select SERIAL_GAISLER
	default n

config FDT_SERIAL_HTIF
	bool "Host transfer interface (HTIF) UART FDT driver"
	select SYS_HTIF
	default n

config FDT_SERIAL_RENESAS_SCIF
	bool "Renesas SCIF FDT driver"
	select SERIAL_RENESAS_SCIF
	default n

config FDT_SERIAL_SHAKTI
	bool "Shakti UART FDT driver"
	select SERIAL_SHAKTI
	default n

config FDT_SERIAL_SIFIVE
	bool "SiFive UART FDT driver"
	select SERIAL_SIFIVE
	default n

config FDT_SERIAL_LITEX
	bool "LiteX UART FDT driver"
	select SERIAL_LITEX
	default n

config FDT_SERIAL_UART8250
	bool "8250 UART FDT driver"
	select SERIAL_UART8250
	default n

config FDT_SERIAL_XILINX_UARTLITE
	bool "Xilinx UART Lite FDT driver"
	select SERIAL_XILINX_UARTLITE
	default n

endif

config SERIAL_CADENCE
	bool "Cadence UART support"
	default n

config SERIAL_GAISLER
	bool "Gaisler UART support"
	default n

config SERIAL_RENESAS_SCIF
	bool "Renesas SCIF support"
	default n

config SERIAL_SHAKTI
	bool "Shakti UART support"
	default n

config SERIAL_SIFIVE
	bool "SiFive UART support"
	default n

config SERIAL_LITEX
	bool "LiteX UART support"
	default n

config SERIAL_UART8250
	bool "8250 UART support"
	default n

config SERIAL_XILINX_UARTLITE
	bool "Xilinx UART Lite support"
	default n

config SERIAL_SEMIHOSTING
	bool "Semihosting support"
	default n

endmenu
```

## tools/opensbi/lib/utils/sys/Kconfig
```kconfig
# SPDX-License-Identifier: BSD-2-Clause

menu "System Device Support"

config SYS_HTIF
	bool "Host transfere interface (HTIF) support"
	default n

config SYS_SIFIVE_TEST
	bool "SiFive test support"
	default n

endmenu
```

## tools/opensbi/platform/fpga/ariane/Kconfig
```kconfig
# SPDX-License-Identifier: BSD-2-Clause

config PLATFORM_ARIANE_FPGA
	bool
	select FDT
	select IPI_MSWI
	select IRQCHIP_PLIC
	select SERIAL_UART8250
	select TIMER_MTIMER
	default y
```

## tools/opensbi/platform/generic/Kconfig
```kconfig
# SPDX-License-Identifier: BSD-2-Clause

config PLATFORM_GENERIC
	bool
	select FDT
	select FDT_DOMAIN
	select FDT_PMU
	default y

if PLATFORM_GENERIC

config PLATFORM_GENERIC_NAME
	string "Platform default name"
	default "Generic"

config PLATFORM_GENERIC_MAJOR_VER
	int "Platform major version"
	range 0 65535
	default 0

config PLATFORM_GENERIC_MINOR_VER
	int "Platform minor version"
	range 0 65535
	default 1

config PLATFORM_ALLWINNER_D1
	bool "Allwinner D1 support"
	depends on FDT_IRQCHIP_PLIC
	default n

config PLATFORM_ANDES_AE350
	bool "Andes AE350 support"
	default n

config PLATFORM_RENESAS_RZFIVE
	bool "Renesas RZ/Five support"
	default n

config PLATFORM_SIFIVE_FU540
	bool "SiFive FU540 support"
	default n

config PLATFORM_SIFIVE_FU740
	bool "SiFive FU740 support"
	depends on FDT_RESET && FDT_I2C
	default n

endif
```

## tools/opensbi/platform/generic/configs/defconfig
```kconfig
CONFIG_PLATFORM_ALLWINNER_D1=y
CONFIG_PLATFORM_ANDES_AE350=y
CONFIG_PLATFORM_RENESAS_RZFIVE=y
CONFIG_PLATFORM_SIFIVE_FU540=y
CONFIG_PLATFORM_SIFIVE_FU740=y
CONFIG_FDT_GPIO=y
CONFIG_FDT_GPIO_SIFIVE=y
CONFIG_FDT_I2C=y
CONFIG_FDT_I2C_SIFIVE=y
CONFIG_FDT_IPI=y
CONFIG_FDT_IPI_MSWI=y
CONFIG_FDT_IPI_PLICSW=y
CONFIG_FDT_IRQCHIP=y
CONFIG_FDT_IRQCHIP_APLIC=y
CONFIG_FDT_IRQCHIP_IMSIC=y
CONFIG_FDT_IRQCHIP_PLIC=y
CONFIG_FDT_RESET=y
CONFIG_FDT_RESET_ATCWDT200=y
CONFIG_FDT_RESET_GPIO=y
CONFIG_FDT_RESET_HTIF=y
CONFIG_FDT_RESET_SIFIVE_TEST=y
CONFIG_FDT_RESET_SUNXI_WDT=y
CONFIG_FDT_RESET_THEAD=y
CONFIG_FDT_SERIAL=y
CONFIG_FDT_SERIAL_CADENCE=y
CONFIG_FDT_SERIAL_GAISLER=y
CONFIG_FDT_SERIAL_HTIF=y
CONFIG_FDT_SERIAL_RENESAS_SCIF=y
CONFIG_FDT_SERIAL_SHAKTI=y
CONFIG_FDT_SERIAL_SIFIVE=y
CONFIG_FDT_SERIAL_LITEX=y
CONFIG_FDT_SERIAL_UART8250=y
CONFIG_FDT_SERIAL_XILINX_UARTLITE=y
CONFIG_FDT_TIMER=y
CONFIG_FDT_TIMER_MTIMER=y
CONFIG_FDT_TIMER_PLMT=y
CONFIG_SERIAL_SEMIHOSTING=y
```

## tools/opensbi/platform/kendryte/k210/Kconfig
```kconfig
# SPDX-License-Identifier: BSD-2-Clause

config PLATFORM_KENDRYTE_K210
	bool
	select FDT
	select IPI_MSWI
	select IRQCHIP_PLIC
	select SERIAL_SIFIVE
	select TIMER_MTIMER
	default y
```

## tools/opensbi/platform/nuclei/ux600/Kconfig
```kconfig
# SPDX-License-Identifier: BSD-2-Clause

config PLATFORM_NUCLEI_UX600
	bool
	select FDT
	select IPI_MSWI
	select IRQCHIP_PLIC
	select SERIAL_SIFIVE
	select TIMER_MTIMER
	default y
```

## tools/opensbi/platform/template/Kconfig
```kconfig
# SPDX-License-Identifier: BSD-2-Clause

#
# All mandatory drivers or libraries for this platform should
# be directly selected by the PLATFORM_xyz kconfig symbol.
#
# All optional drivers or libraries for this platform should
# be enabled via configs/defconfig of this platform.
#
config PLATFORM_TEMPLATE
	bool
	select IPI_MSWI
	select IRQCHIP_PLIC
	select SERIAL_UART8250
	select TIMER_MTIMER
	default y
```
